## nemu/configs/riscv32-nemu_defconfig
```kconfig
CONFIG_ISA_riscv=y
# CONFIG_RV64 is not set
CONFIG_ENGINE_INTERPRETER=y
CONFIG_MODE_SYSTEM=y
# CONFIG_TARGET_NATIVE_ELF is not set
CONFIG_CC_GCC=y
CONFIG_CC_O2=y
CONFIG_TRACE=y
CONFIG_ITRACE=y
CONFIG_MTRACE=y
CONFIG_DEVICE=y
CONFIG_RT_CHECK=y
CONFIG_TARGET_SHARE=y
```
